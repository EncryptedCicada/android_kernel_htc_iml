/* Copyright (c) 2017, The Linux Foundation. All rights reserved.
*
* This program is free software; you can redistribute it and/or modify
* it under the terms of the GNU General Public License version 2 and
* only version 2 as published by the Free Software Foundation.
*
* This program is distributed in the hope that it will be useful,
* but WITHOUT ANY WARRANTY; without even the implied warranty of
* MERCHANTABILITY or FITNESS FOR A PARTICULAR PURPOSE.  See the
* GNU General Public License for more details.
*/

qcom,iml_longcheer_l2052_jiade {
	qcom, = <24>;
	/* #3494336_longcheer_l2052jiade_3600mah_averaged_masterslave_jul9th2018 */
	qcom,max-voltage-uv = <4400000>;
	qcom,fastchg-current-ma = <2150>;
	qcom,fg-cc-cv-threshold-mv = <4390>;
	qcom,nom-batt-capacity-mah = <3600>;
	qcom,batt-id-kohm = <47>;
	qcom,battery-beta = <3435>;
	qcom,battery-type = "3494336_longcheer_l2052jiade_3600mah_averaged_masterslave_jul9th2018";
	qcom,checksum = <0x107>;
	qcom,gui-version = "PM660GUI - 0.0.0.45";
	qcom,fg-profile-data = [
	b0 1e 97 fd
	d1 02 df f5
	e4 1c b9 fb
	ec 0d 62 0a
	e8 17 bf 23
	78 44 47 5a
	70 00 00 00
	10 00 00 00
	00 00 08 b5
	40 cd 89 c2
	25 00 08 00
	82 da a8 e5
	25 05 d1 fb
	ff 04 06 12
	0a d5 7e 2a
	33 06 09 20
	27 00 14 00
	0f 1f 88 06
	3e 03 e5 f4
	8b 1c c7 03
	2a 15 31 13
	49 18 57 2a
	e4 4c df 62
	5c 00 00 00
	0b 00 00 00
	00 00 f8 cc
	2a ca 9f c5
	18 00 00 00
	71 e3 a8 e5
	73 fc 0f fa
	7f f5 dd 02
	aa f3 5c 22
	b9 33 cc ff
	07 10 00 00
	04 0e 66 46
	18 00 40 00
	b9 01 0a fa
	ff 00 00 00
	00 00 00 00
	00 00 00 00
	00 00 00 00
	00 00 00 00
	00 00 00 00
	00 00 00 00
	00 00 00 00
	00 00 00 00
	00 00 00 00
	00 00 00 00
	00 00 00 00
	00 00 00 00
	00 00 00 00
	00 00 00 00
	00 00 00 00
	00 00 00 00
	00 00 00 00
	00 00 00 00
	];
};
