&int_codec {
    status = "okay";
    compatible = "qcom,sdm660-asoc-snd";
    qcom,model = "sdm660-snd-card";
    qcom,wcn-btfm;
    qcom,mi2s-audio-intf;
    qcom,auxpcm-audio-intf;
    qcom,ext-disp-audio-rx;
    qcom,msm-mi2s-master = <1>, <1>, <1>, <1>;
    qcom,msm-mclk-freq = <9600000>;
    qcom,msm-mbhc-hphl-swh = <1>;
    qcom,msm-mbhc-gnd-swh = <1>;
    /delete-property/ qcom,msm-micbias2-ext-cap;
    qcom,msm-hs-micbias-type = "external";
    qcom,wsa-disable;
    /delete-property/ qcom,us-euro-gpios;
    qcom,cdc-pdm-gpios = <&cdc_pdm_gpios>;
    qcom,cdc-comp-gpios = <&cdc_comp_gpios>;
    qcom,cdc-dmic-gpios = <&cdc_dmic_gpios>;
    pinctrl-names = "pri_i2s_active", "pri_i2s_sleep";
    pinctrl-0 = <&pri_mi2s_sck_active &pri_mi2s_ws_active &pri_mi2s_sd0_active &pri_mi2s_sd1_active>;
    pinctrl-1 = <&pri_mi2s_sck_sleep &pri_mi2s_ws_sleep &pri_mi2s_sd0_sleep &pri_mi2s_sd1_sleep>;
    qcom,audio-routing =
        "RX_BIAS", "INT_MCLK0",
        "SPK_RX_BIAS", "INT_MCLK0",
        "INT_LDO_H", "INT_MCLK0",
        "RX_I2S_CLK", "INT_MCLK0",
        "TX_I2S_CLK", "INT_MCLK0",
        "MIC BIAS External", "Handset Mic",
        "MIC BIAS External2", "Headset Mic",
        "MIC BIAS External", "Secondary Mic",
        "AMIC1", "MIC BIAS External",
        "AMIC2", "MIC BIAS External2",
        "AMIC3", "MIC BIAS External",
        "DMIC1", "MIC BIAS External",
        "MIC BIAS External", "Digital Mic1",
        "DMIC2", "MIC BIAS External",
        "MIC BIAS External", "Digital Mic2",
        "DMIC3", "MIC BIAS External",
        "MIC BIAS External", "Digital Mic3",
        "DMIC4", "MIC BIAS External",
        "MIC BIAS External", "Digital Mic4",
        "SpkrLeft IN", "SPK1 OUT",
        "SpkrRight IN", "SPK2 OUT",
        "PDM_IN_RX1", "PDM_OUT_RX1",
        "PDM_IN_RX2", "PDM_OUT_RX2",
        "PDM_IN_RX3", "PDM_OUT_RX3",
        "ADC1_IN", "ADC1_OUT",
        "ADC2_IN", "ADC2_OUT",
        "ADC3_IN", "ADC3_OUT";

    asoc-platform = <&pcm0>, <&pcm1>, <&pcm2>, <&voip>, <&voice>,
            <&loopback>, <&compress>, <&hostless>,
            <&afe>, <&lsm>, <&routing>, <&compr>,
            <&pcm_noirq>;
    asoc-platform-names = "msm-pcm-dsp.0", "msm-pcm-dsp.1",
            "msm-pcm-dsp.2", "msm-voip-dsp",
            "msm-pcm-voice", "msm-pcm-loopback",
            "msm-compress-dsp", "msm-pcm-hostless",
            "msm-pcm-afe", "msm-lsm-client",
            "msm-pcm-routing", "msm-compr-dsp",
            "msm-pcm-dsp-noirq";
    asoc-cpu = <&dai_dp>, <&dai_mi2s0>,
            <&dai_mi2s1>,
            <&dai_mi2s2>, <&dai_mi2s3>,
            <&dai_int_mi2s0>, <&dai_int_mi2s1>,
            <&dai_int_mi2s2>, <&dai_int_mi2s3>,
            <&dai_int_mi2s4>, <&dai_int_mi2s5>,
            <&dai_pri_auxpcm>, <&dai_sec_auxpcm>,
            <&dai_tert_auxpcm>, <&dai_quat_auxpcm>,
            <&afe_pcm_rx>, <&afe_pcm_tx>, <&afe_proxy_rx>,
            <&afe_proxy_tx>, <&incall_record_rx>,
            <&incall_record_tx>, <&incall_music_rx>,
            <&incall_music_2_rx>, <&sb_7_rx>, <&sb_7_tx>,
            <&sb_8_tx>, <&sb_8_rx>,
            <&usb_audio_rx>, <&usb_audio_tx>,
            <&dai_pri_tdm_rx_0>, <&dai_pri_tdm_tx_0>,
            <&dai_sec_tdm_rx_0>, <&dai_sec_tdm_tx_0>,
            <&dai_tert_tdm_rx_0>, <&dai_tert_tdm_tx_0>,
            <&dai_quat_tdm_rx_0>, <&dai_quat_tdm_tx_0>,
            <&proxy_rx>, <&proxy_tx>;
    asoc-cpu-names = "msm-dai-q6-dp.24608", "msm-dai-q6-mi2s.0",
            "msm-dai-q6-mi2s.1",
            "msm-dai-q6-mi2s.2", "msm-dai-q6-mi2s.3",
            "msm-dai-q6-mi2s.7", "msm-dai-q6-mi2s.8",
            "msm-dai-q6-mi2s.9", "msm-dai-q6-mi2s.10",
            "msm-dai-q6-mi2s.11", "msm-dai-q6-mi2s.12",
            "msm-dai-q6-auxpcm.1", "msm-dai-q6-auxpcm.2",
            "msm-dai-q6-auxpcm.3", "msm-dai-q6-auxpcm.4",
            "msm-dai-q6-dev.224", "msm-dai-q6-dev.225",
            "msm-dai-q6-dev.241", "msm-dai-q6-dev.240",
            "msm-dai-q6-dev.32771", "msm-dai-q6-dev.32772",
            "msm-dai-q6-dev.32773", "msm-dai-q6-dev.32770",
            "msm-dai-q6-dev.16398", "msm-dai-q6-dev.16399",
            "msm-dai-q6-dev.16401", "msm-dai-q6-dev.16400",
            "msm-dai-q6-dev.28672", "msm-dai-q6-dev.28673",
            "msm-dai-q6-tdm.36864", "msm-dai-q6-tdm.36865",
            "msm-dai-q6-tdm.36880", "msm-dai-q6-tdm.36881",
            "msm-dai-q6-tdm.36896", "msm-dai-q6-tdm.36897",
            "msm-dai-q6-tdm.36912", "msm-dai-q6-tdm.36913",
            "msm-dai-q6-dev.8194", "msm-dai-q6-dev.8195";
    asoc-codec = <&stub_codec>, <&msm_digital_codec>,
            <&pmic_analog_codec>, <&msm_sdw_codec>,
            <&ext_disp_audio_codec>;
    asoc-codec-names = "msm-stub-codec.1", "msm-dig-codec",
                "analog-codec", "msm_sdw_codec",
                "msm-ext-disp-audio-codec-rx";

    qcom,wsa-max-devs = <2>;
    qcom,wsa-devs = <&wsa881x_211_en>, <&wsa881x_212_en>,
            <&wsa881x_213_en>, <&wsa881x_214_en>;
    qcom,wsa-aux-dev-prefix = "SpkrLeft", "SpkrRight",
                  "SpkrLeft", "SpkrRight";
};

&i2c_6 {
    tas2560s@4c {
        compatible = "ti,tas2560s";
        reg = <0x4c>;
        ti,reset-gpio = <&tlmm 77 0>;
        ti,irq-gpio1 = <&tlmm 56 0>;
        ti,irq-gpio2 = <&tlmm 73 0>;
        ti,left-channel = <0x4f>;
        ti,right-channel = <0x4c>;
        ti,pll = <1>; /* refer to tas2560.h for more details */
        ti,asi-format = <1>; /* 0, i2S; 1, DSP;  */
        ti,left-load = <0>; /* 0, 8Ohm; 1, 6Ohm; 2, 4Ohm */
        ti,right-load = <1>; /* 0, 8Ohm; 1, 6Ohm; 2, 4Ohm */
        ti,ppg = <0>; /* 0, 0dB default; 1， enable -2dB */
        i2c-pull-up;
        status = "ok";
    };
};
