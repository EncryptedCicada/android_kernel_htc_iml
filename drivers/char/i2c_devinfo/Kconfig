## drivers/char/i2c_devinfo/Kconfig
```kconfig
config I2C_DEVINFO
    tristate "I2C devices info for I2C testing"
    default y
    help
      This is the i2c-devinfo driver for android system
```

## drivers/input/touchscreen/ssl_ssd20xx/Kconfig
```kconfig
config TOUCHSCREEN_SSL_SSD20xx
	bool "SOLOMON SSD20xx Touchscreen"
	depends on I2C
	help
	  Say Y here if you have a Solomon Touchscreen connected to your system.

	  If unsure, say N.

config TOUCHSCREEN_SSL_SSD2098
	bool "Warnings for Solomon Touchscreen"
	depends on TOUCHSCREEN_SSL_SSD20xx
	help
	  Say Y here to enable support for SSD2098 touchscreen.

	  If unsure, say Y.

config SOLOMON_WARNINGS
    bool "Warnings for Solomon Touchscreen"
	depends on TOUCHSCREEN_SSL_SSD20xx
	help
	  Say Y here to enable warning logs for Solomon touch driver.

	  If unsure, say Y.

config SOLOMON_DEBUGGING
    bool "Debugging for Solomon Touchscreen"
	depends on TOUCHSCREEN_SSL_SSD20xx && SOLOMON_WARNINGS
	help
	  Say Y here to enable debug logs for Solomon touch driver.

	  If unsure, say N.

config SOLOMON_TIMECHECK
    bool "Timecheck for Solomon Touchscreen"
	depends on TOUCHSCREEN_SSL_SSD20xx
	help
	  Say Y here to enable action completion time logging for Solomon touch driver.

	  If unsure, say N.
```

## drivers/platform/htc/Kconfig
```kconfig
# HTC configuration options

config MACH_HTC_SDM660
	bool "HTC SDM660"
	depends on ARCH_SDM660
	help
	  Support for SDM660 HTC variants

menu "HTC board selection"

config MACH_HTC_IML
        bool "Iml board"
        select MACH_HTC_SDM660
        help
          Support for HTC U12 Life

endmenu
```
